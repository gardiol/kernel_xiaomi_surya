/* Copyright (c) 2018, The Linux Foundation. All rights reserved.
 * Copyright (C) 2020 XiaoMi, Inc.
 *
 * This program is free software; you can redistribute it and/or modify
 * it under the terms of the GNU General Public License version 2 and
 * only version 2 as published by the Free Software Foundation.
 *
 * This program is distributed in the hope that it will be useful,
 * but WITHOUT ANY WARRANTY; without even the implied warranty of
 * MERCHANTABILITY or FITNESS FOR A PARTICULAR PURPOSE.  See the
 * GNU General Public License for more details.
 */

/dts-v1/;
/plugin/;

#include <dt-bindings/interrupt-controller/arm-gic.h>
#include <dt-bindings/clock/qcom,camcc-sdmmagpie.h>

#include "xiaomi/surya/surya-sdmmagpie-idp.dtsi"
#include "xiaomi/surya/surya-haptic-overlay.dtsi"
#include "xiaomi/surya/surya-touchscreen-overlay.dtsi"
#include "xiaomi/surya/surya-audio-overlay.dtsi"
#include "xiaomi/surya/surya-video-overlay.dtsi"
#include "xiaomi/surya/surya-sdmmagpie-idp-pinctrl.dtsi"

/ {
	model = "SURYA";
	compatible = "qcom,sdmmagpie-idp", "qcom,sdmmagpie", "qcom,idp";
	qcom,msm-id = <365 0x0>;
	qcom,board-id = <34 0>;
};
